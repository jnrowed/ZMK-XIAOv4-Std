#include "skreecustom.dtsi"

 &default_transform {
    col-offset = <6>;
};

&kscan0 {
    col-gpios           // Col1-7 1.07 1.14 1.05 1.13 1.03 1.12 0.16 
        = <&gpio1 7 GPIO_ACTIVE_HIGH> 
        , <&gpio1 14 GPIO_ACTIVE_HIGH>
        , <&gpio1 5 GPIO_ACTIVE_HIGH>
        , <&gpio1 13 GPIO_ACTIVE_HIGH> 
        , <&gpio1 3 GPIO_ACTIVE_HIGH> 
        , <&gpio1 12 GPIO_ACTIVE_HIGH> 
//      , <&gpio0 16 GPIO_ACTIVE_HIGH> 
        ;
};
