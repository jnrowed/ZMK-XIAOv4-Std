## boards/shields/skreecustom/Kconfig.defconfig
```kconfig
if SHIELD_SKREECUSTOM_LEFT

config ZMK_KEYBOARD_NAME
    default "Skree Custom"

config ZMK_SPLIT_ROLE_CENTRAL
    default y

endif

if SHIELD_SKREECUSTOM_LEFT || SHIELD_SKREECUSTOM_RIGHT

config ZMK_SPLIT
    default y

config ZMK_SLEEP
    default y

config ZMK_POINTING
    default y

config ZMK_POINTING_SMOOTH_SCROLLING
    default n

config SPI
    default y

config PMW3610
    default y

config PMW3610_SWAP_XY
    default y

config PMW3610_REPORT_INTERVAL_MIN
    default 8

config ZMK_RGB_UNDERGLOW_EXT_POWER
    default n

config ZMK_KSCAN_MATRIX_WAIT_BEFORE_INPUTS
    default 0

config ZMK_KSCAN_MATRIX_WAIT_BETWEEN_OUTPUTS
    default 1


endif

config ZMK_RGB_UNDERGLOW
    default y
    imply WS2812_STRIP
```

## config/west.yml
```yaml
manifest:
  remotes:
    - name: zmkfirmware
      url-base: https://github.com/zmkfirmware
    # Additional modules containing boards/shields/custom code can be listed here as well
    # See https://docs.zephyrproject.org/3.2.0/develop/west/manifest.html#projects
    - name: awkannan
      url-base: https://github.com/awkannan
#   - name: badjeff
#     url-base: https://github.com/badjeff
#   - name: Cyboard-DigitalTailor
#     url-base: https://github.com/Cyboard-DigitalTailor
  projects:
    - name: zmk
      remote: awkannan
      revision: develop
      import: app/west.yml
    - name: zmk-smart-rgbled-widget
      remote: awkannan
      revision: main
#   - name: zmk-pmw3610-driver
#     remote: badjeff
#     revision: zmk-0.3
  self:
    path: config
```
